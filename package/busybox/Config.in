## package/busybox/Config.in
```kconfig
if PACKAGE_busybox

config BUSYBOX_USE_LIBRPC
	bool
	depends USE_UCLIBC
	default y if BUSYBOX_CONFIG_FEATURE_HAVE_RPC

config BUSYBOX_USE_LIBTIRPC
	bool
	depends USE_EGLIBC
	default y if BUSYBOX_CONFIG_FEATURE_HAVE_RPC

source "package/busybox/config/Config.in"

endif
```

## package/utils/busybox/Config.in
```kconfig
if PACKAGE_busybox

config BUSYBOX_CONFIG_FEATURE_MOUNT_NFS
	bool "Enable NFS mount support"

config BUSYBOX_CONFIG_PAM
	bool "Enable PAM support"

endif
```
